static const unsigned char PROGMEM image_FaceNormal_bits[] = {0x00,0x00,0x00,0x00,0x3c,0x00,0x01,0xe0,0x7a,0x00,0x03,0xd0,0x7e,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0x00,0x00};

static const unsigned char PROGMEM image_FaceNopower_bits[] = {0x00,0x00,0x00,0x00,0x03,0x00,0x06,0x00,0x03,0x00,0x06,0x00,0x07,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0x00,0x00};

static const unsigned char PROGMEM image_FaceCharging_bits[] = {0x02,0x00,0x00,0x40,0x06,0x00,0x00,0xc0,0x0c,0x00,0x01,0x80,0x18,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0x80,0x00};

static const unsigned char PROGMEM image_FaceConfused_bits[] = {0x01,0x00,0x01,0xf0,0x1c,0x80,0x02,0x08,0x22,0x80,0x04,0xe0,0x4a,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0xf8,0x00};


// Face Logic Variables
unsigned long lastFaceDrawTime = 0;
int faceDrawInterval;  // Initial random interval
int mode = (esp_random() % 2) ? 3 : 0;

int xPositions[] = {13, 14, 15, 16, 17, 18, 19, 20, 21, 22, 23}; 
int yPositions[] = {40, 41, 42, 43, 44, 45, 46, 47, 48, 49, 50, 51, 52, 53, 54, 55, 56}; 

void clearFaceArea() {
  tft.fillRect(12, 39, (54 - 11) - 2, (72 - 38) - 2, 0x0); // Leaves 1px border
}

void drawRandomFace() {
  if (millis() - lastFaceDrawTime >= faceDrawInterval) {
    lastFaceDrawTime = millis();      
    if (mode == 1){
      faceDrawInterval = 100;
    }      
    else {
      faceDrawInterval = random(1500, 5001);   // Set new random interval
      mode = (esp_random() % 2) ? 2 : 0; // Randomize face
    }

    clearFaceArea();

    int xIndex = random(0, sizeof(xPositions) / sizeof(xPositions[0]));  // Picks any valid x index
    int yIndex = random(0, sizeof(yPositions) / sizeof(yPositions[0]));  // Picks any valid y index

    int x = xPositions[xIndex];  
    int y = yPositions[yIndex];

    switch (mode) {
      case 0:
        tft.drawBitmap(x, y, image_FaceNormal_bits, 29, 14, 0xFFFF);
        break;
      case 1:
        tft.drawBitmap(x, y, image_FaceCharging_bits, 29, 14, 0xFFFF);
        break;
      case 2:
        tft.drawBitmap(x, y, image_FaceConfused_bits, 29, 14, 0xFFFF);
        break;
      case 3:
        tft.drawBitmap(x, y, image_FaceNopower_bits, 29, 14, 0xFFFF);
        break;
    }
  }
}